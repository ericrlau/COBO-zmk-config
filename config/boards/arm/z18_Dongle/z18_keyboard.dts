/*
 * Copyright (c) 2021 Eric Lau
 *
 * SPDX-License-Identifier: MIT
 */

#include "z18.dtsi"

&kscan0 {
	col-gpios
		= <&gpio1  6 GPIO_ACTIVE_HIGH> 
		, <&gpio1 10 GPIO_ACTIVE_HIGH>
		, <&gpio1  4 GPIO_ACTIVE_HIGH>
		, <&gpio1 11 GPIO_ACTIVE_HIGH>
		, <&gpio1  2 GPIO_ACTIVE_HIGH>
		, <&gpio0  3 GPIO_ACTIVE_HIGH>
		, <&gpio1  0 GPIO_ACTIVE_HIGH>
		, <&gpio0 28 GPIO_ACTIVE_HIGH>
		, <&gpio1 13 GPIO_ACTIVE_HIGH>
		, <&gpio0 22 GPIO_ACTIVE_HIGH>		
		, <&gpio0 29 GPIO_ACTIVE_HIGH>
		, <&gpio0 20 GPIO_ACTIVE_HIGH>
		, <&gpio0 17 GPIO_ACTIVE_HIGH>
		, <&gpio0  2 GPIO_ACTIVE_HIGH>		
		, <&gpio0  5 GPIO_ACTIVE_HIGH>
		, <&gpio0 15 GPIO_ACTIVE_HIGH>
		, <&gpio1  9 GPIO_ACTIVE_HIGH>
		, <&gpio0  7 GPIO_ACTIVE_HIGH>
		;
		
	row-gpios
		= <&gpio0 10 (GPIO_ACTIVE_HIGH | GPIO_PULL_DOWN)>
		, <&gpio0  9 (GPIO_ACTIVE_HIGH | GPIO_PULL_DOWN)>
		, <&gpio0 24 (GPIO_ACTIVE_HIGH | GPIO_PULL_DOWN)>
		, <&gpio0 13 (GPIO_ACTIVE_HIGH | GPIO_PULL_DOWN)>
		, <&gpio0 12 (GPIO_ACTIVE_HIGH | GPIO_PULL_DOWN)>
		;

	};
