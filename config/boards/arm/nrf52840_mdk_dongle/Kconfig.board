## config/boards/arm/nrf52840_mdk_dongle/Kconfig.board
```kconfig
#
# Copyright (c) 2020 The ZMK Contributors
# SPDX-License-Identifier: MIT
#

config BOARD_NRF52840_MDK_DONGLE
	bool "NRF52840-MDK-DONGLE"
	depends on SOC_NRF52840_QIAA
```

## config/boards/arm/sp56/Kconfig.defconfig
```kconfig
# Copyright (c) 2020 Eric Lau
# SPDX-License-Identifier: MIT

if BOARD_SP56_LEFT

	config ZMK_KEYBOARD_NAME
	default "DaBunckBoard"

endif # BOARD_SP56_LEFT

if BOARD_SP56_RIGHT

	config ZMK_KEYBOARD_NAME
	default "SP56 (right)"

endif # BOARD_SP56_RIGHT


if BOARD_SP56_LEFT || BOARD_SP56_RIGHT

config BOARD
	default "sp56"

config ZMK_SPLIT
	default y

menuconfig SENSOR
    bool "Sensor Drivers"

config BT_CTLR
	default BT

config ZMK_BLE
	default y

config ZMK_USB
	default y

config ZMK_BATTERY_VOLTAGE_DIVIDER
	default y

if USB

config USB_NRFX
	default y

config USB_DEVICE_STACK
	default y

endif # USB

endif # BOARD_SP56_LEFT || BOARD_SP56_RIGHT
```

## config/boards/arm/z18/Kconfig.board
```kconfig
# Z18 board configuration

# Copyright (c) 2021 Eric Lau
# SPDX-License-Identifier: MIT

config BOARD_Z18_KEYBOARD
	bool "Z18_KEYBOARD"
	depends on SOC_NRF52840_QIAA

config BOARD_Z18_DONGLE
	bool "Z18_USB"
	depends on SOC_NRF52840_QIAA
```

## config/boards/arm/z18/Kconfig.defconfig
```kconfig
# Copyright (c) 2021 Eric Lau
# SPDX-License-Identifier: MIT

if BOARD_Z18

	config ZMK_KEYBOARD_NAME
	default "z18"

endif


if BOARD_Z18

config BOARD
	default "z18"

menuconfig SENSOR
    bool "Sensor Drivers"

config BT_CTLR
	default BT

config ZMK_BLE
	default y

config ZMK_USB
	default y

config ZMK_BATTERY_VOLTAGE_DIVIDER
	default y

if USB

config USB_NRFX
	default y

config USB_DEVICE_STACK
	default y

endif # USB

endif 
```

## config/boards/arm/z18/z18_defconfig
```kconfig
# SPDX-License-Identifier: MIT

CONFIG_SOC_SERIES_NRF52X=y
CONFIG_SOC_NRF52840_QIAA=y
CONFIG_BOARD_Z18=y
# CONFIG_ZMK_SPLIT=y
# CONFIG_ZMK_SPLIT_BLE_ROLE_CENTRAL=y
CONFIG_ZMK_SLEEP=y

# Enable MPU
CONFIG_ARM_MPU=y

# enable GPIO
CONFIG_GPIO=y

# Enable writing to flash
CONFIG_USE_DT_CODE_PARTITION=y
CONFIG_MPU_ALLOW_FLASH_WRITE=y
CONFIG_NVS=y
CONFIG_SETTINGS_NVS=y
CONFIG_FLASH=y
CONFIG_FLASH_PAGE_LAYOUT=y
CONFIG_FLASH_MAP=y

# Enable external crystal
CONFIG_CLOCK_CONTROL_NRF_K32SRC_XTAL=y
CONFIG_CLOCK_CONTROL_NRF_K32SRC_30PPM=y

# Enable Encoder
# CONFIG_EC11=y
# CONFIG_EC11_TRIGGER_GLOBAL_THREAD=y

# Turn on logging, and set ZMK logging to debug output
CONFIG_ZMK_USB_LOGGING=y
```

## config/boards/arm/z18_MDK/Kconfig.board
```kconfig
# SF65 board configuration

# Copyright (c) 2021 Eric Lau
# SPDX-License-Identifier: MIT

config BOARD_Z18
	bool "Z18"
	depends on SOC_NRF52840_QIAA

config BOARD_DONGLE
	bool "Z18_USB"
	depends on SOC_NRF52840_QIAA
```
